## boards/arm/keymini/Kconfig.board
```kconfig
# SPDX-License-Identifier: MIT

config BOARD_KEYMINI
	bool "Keymini"
	depends on SOC_STM32F072XB
```

## boards/arm/keymini/Kconfig.defconfig
```kconfig
# SPDX-License-Identifier: MIT

if BOARD_KEYMINI

config BOARD
	default "keymini"

config ZMK_KEYBOARD_NAME
	default "Keymini"

config ZMK_USB
	default y

config ZMK_KSCAN_MATRIX_POLLING
	default y

endif # BOARD_KEYMINI
```

## boards/arm/keymini/keymini_defconfig
```kconfig
# SPDX-License-Identifier: MIT

CONFIG_BOARD_KEYMINI=y
CONFIG_SOC_SERIES_STM32F0X=y
CONFIG_SOC_STM32F072XB=y
CONFIG_SYS_CLOCK_HW_CYCLES_PER_SEC=48000000
CONFIG_PINCTRL=y
CONFIG_GPIO=y
CONFIG_CLOCK_CONTROL=y
CONFIG_ZMK_USB=y
CONFIG_USB_SELF_POWERED=n
CONFIG_ZMK_KSCAN_MATRIX_POLLING=y

# Needed to reduce this to size that will fit on F072
CONFIG_HEAP_MEM_POOL_SIZE=1024
```

## config/west.yml
```yaml
manifest:
  remotes:
    - name: zmkfirmware
      url-base: https://github.com/zmkfirmware
    - name: OneDeadKey
      url-base: https://github.com/OneDeadKey/
  projects:
    - name: zmk
      remote: zmkfirmware
      revision: v0.3.0
      import: app/west.yml
    - name: zmk-config-aekeynox
      remote: OneDeadKey
      revision: main
  self:
    path: config
```
